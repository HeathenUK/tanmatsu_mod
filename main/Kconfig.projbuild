## main/Kconfig.projbuild
```kconfig
# MOD Playback Backend Selection
# This allows choosing between libxmp and libopenmpt at build time via menuconfig

menu "MOD Playback Configuration"

    choice MOD_BACKEND
        prompt "MOD Playback Backend"
        default MOD_BACKEND_OPENMPT
        help
            Select which backend library to use for MOD file playback.
            Only the selected backend will be compiled and linked, keeping the binary size minimal.

        config MOD_BACKEND_XMP
            bool "libxmp"
            help
                Lightweight C library for MOD playback.
                Smaller binary size, faster startup, fewer features.

        config MOD_BACKEND_OPENMPT
            bool "libopenmpt"
            help
                High-quality C++ library for MOD playback.
                Larger binary size, better accuracy, more format support.

        config MOD_BACKEND_MICROMOD
            bool "micromod (IBXM)"
            help
                Lightweight MOD/XM/S3M replay library.
                Very small footprint, fast loading, good quality.
                Supports MOD, XM, and S3M formats with pattern data access.
    endchoice

endmenu

menu "VGM Playback Configuration"

    config VGM_ENABLE
        bool "Enable VGM/VGZ playback"
        default y
        help
            Enable playback of VGM (Video Game Music) and VGZ (compressed VGM) files.
            VGM files are chip register logs from classic game consoles.

    config VGM_ENABLE_SEGACD
        bool "Enable Sega CD PCM support"
        depends on VGM_ENABLE
        default n
        help
            Enable Sega CD PCM chip emulation for VGM files that use it.
            Increases binary size.

    config VGM_ENABLE_YM2151
        bool "Enable YM2151 support"
        depends on VGM_ENABLE
        default n
        help
            Enable YM2151 (OPM) chip emulation for arcade VGM files.
            Increases binary size.

endmenu
```
